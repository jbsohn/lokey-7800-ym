; *************************************************
; *                                               *
; *   stella.inc -- 2600 GAME SYSTEM EQUATES      *
; *   Converted to ca65 from SDK Original         *
; *                                               *
; *************************************************

; --- STELLA (TIA) REGISTER ADDRESSES ---

VSYNC       = $00 ; BIT          1  VERTICAL SYNC SET-CLR
VBLANK      = $01 ; BIT          1  VERTICAL BLANK SET-CLR
WSYNC       = $02 ; STROBE       WAIT FOR HORIZ BLANK
RSYNC       = $03 ; STROBE       HORIZ SYNC COUNTER
NUSIZ0      = $04 ; BITS   54 210  NUMBER-SIZE PLAYER/MISSILE 0
NUSIZ1      = $05 ; BITS   54 210  NUMBER-SIZE PLAYER/MISSILE 1
COLUP0      = $06 ; BITS 7654321  COLOR(4)-LUM(3) PLAYER 0
COLUP1      = $07 ; BITS 7654321  COLOR(4)-LUM(3) PLAYER 1
COLUPF      = $08 ; BITS 7654321  COLOR(4)-LUM(3) PLAYFIELD
COLUBK      = $09 ; BITS 7654321  COLOR(4)-LUM(3) BACKGROUND
CTRLPF      = $0A ; BITS 7 54 210  PLAYFIELD CONTROL
REFP0       = $0B ; BIT      3  REFLECT PLAYER 0
REFP1       = $0C ; BIT      3  REFLECT PLAYER 1
PF0         = $0D ; BITS 7654    PLAYFIELD REG BYTE 0
PF1         = $0E ; BITS ALL     PLAYFIELD REG BYTE 1
PF2         = $0F ; BITS ALL     PLAYFIELD REG BYTE 2
RESP0       = $10 ; STROBE       RESET PLAYER 0
RESP1       = $11 ; STROBE       RESET PLAYER 1
RESM0       = $12 ; STROBE       RESET MISSILE 0
RESM1       = $13 ; STROBE       RESET MISSILE 1
RESBL       = $14 ; STROBE       RESET BALL
AUDC0       = $15 ; BITS       3210  AUDIO CONTROL 0
AUDC1       = $16 ; BITS       3210  AUDIO CONTROL 1
AUDF0       = $17 ; BITS       3210  AUDIO FREQUENCY 0
AUDF1       = $18 ; BITS       3210  AUDIO FREQUENCY 1
AUDV0       = $19 ; BITS       3210  AUDIO VOLUME 0
AUDV1       = $1A ; BITS       3210  AUDIO VOLUME 1
GRP0        = $1B ; BITS ALL     GRAPHICS FOR PLAYER 0
GRP1        = $1C ; BITS ALL     GRAPHICS FOR PLAYER 1
ENAM0       = $1D ; BIT          1  ENABLE MISSILE 0
ENAM1       = $1E ; BIT          1  ENABLE MISSILE 1
ENABL       = $1F ; BIT          1  ENABLE BALL
HMP0        = $20 ; BITS 7654    HORIZ MOTION PLAYER 0
HMP1        = $21 ; BITS 7654    HORIZ MOTION PLAYER 1
HMM0        = $22 ; BITS 7654    HORIZ MOTION MISSILE 0
HMM1        = $23 ; BITS 7654    HORIZ MOTION MISSILE 1
HMBL        = $24 ; BITS 7654    HORIZ MOTION BALL
VDELP0      = $25 ; BIT          0  VERTICAL DELAY PLAYER 0
VDELP1      = $26 ; BIT          0  VERTICAL DELAY PLAYER 1
VDELBL      = $27 ; BIT          0  VERTICAL DELAY BALL
RESMP0      = $28 ; BIT          1  RESET MISSILE TO PLAYER 0
RESMP1      = $29 ; BIT          1  RESET MISSILE TO PLAYER 1
HMOVE       = $2A ; STROBE       ACT ON HORIZ MOTION
HMCLR       = $2B ; STROBE       CLEAR ALL HM REGISTERS
CXCLR       = $2C ; STROBE       CLEAR COLLISION LATCHES

; --- READ ADDRESSES -    BIT 7    BIT 6 (ONLY) ---

CXM0P       = $00 ; M0.P1  M0.P0
CXM1P       = $01 ; M1.P0  M1.P1
CXP0FB      = $02 ; P0.PF  P0.BL
CXP1FB      = $03 ; P1.PF  P1.BL
CXM0FB      = $04 ; M0.PF  M0.BL
CXM1FB      = $05 ; M1.PF  M1.BL
CXBLPF      = $06 ; BL.PF  NOT USED
CXPPMM      = $07 ; P0.P1  M0.M1

; --- PADDLE INPUT PORTS ---

INPT0       = $08
INPT1       = $09
INPT2       = $0A
INPT3       = $0B

INPT4       = $0C ; D7=0 WHEN LEFT JOYSTICK FIREBUTTON PRESSED
INPT5       = $0D ; D7=0 WHEN RITE JOYSTICK FIREBUTTON PRESSED

; --- PIA AND TIMER (6532) LOCATIONS ---

SWCHA       = $0280 ; P0,P1 JOYSTICKS
;   LEFT RITE
;   7654 3210   ; BIT POSITION (=0 IF SWITCH IS CLOSED)
;   ---- ----
;   RLDU RLDU   ; RIGHT/LEFT/DOWN/UP

CTLSWA      = $0281 ; SWCHA DATA DIRECTION (0=INPUT)

SWCHB       = $0282 ; CONSOLE SWITCHES
;   D7-RITE DIFFICULTY
;   D6-LEFT DIFFICULTY
;   D5/D4 NOT USED
;   D3-COLOR - B/W
;   D2-NOT USED
;   D1-GAME SELECT
;   D0-GAME RESET

CTLSWB      = $0283 ; SWCHB DATA DIRECTION (0=INPUT)

INTIM       = $0284 ; INTERVAL TIMER READ
TIM1T       = $0294 ; SET 1    CLK INTERVAL (838   NSEC/INTERVAL)
TIM8T       = $0295 ; SET 8    CLK INTERVAL (6.7   USEC/INTERVAL)
TIM64T      = $0296 ; SET 64   CLK INTERVAL (53.6  USEC/INTERVAL)
T1024T      = $0297 ; SET 1024 CLK INTERVAL (858.2 USEC/INTERVAL)
